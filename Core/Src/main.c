/* USER CODE BEGIN Header */
/**
  ******************************************************************************
  * @file           : main.c
  * @brief          : Main program body
  ******************************************************************************
  * @attention
  *
  * <h2><center>&copy; Copyright (c) 2021 STMicroelectronics.
  * All rights reserved.</center></h2>
  *
  * This software component is licensed by ST under BSD 3-Clause license,
  * the "License"; You may not use this file except in compliance with the
  * License. You may obtain a copy of the License at:
  *                        opensource.org/licenses/BSD-3-Clause
  *
  ******************************************************************************
  */
/* USER CODE END Header */
/* Includes ------------------------------------------------------------------*/
#include "main.h"
#include "i2c.h"
#include "rtc.h"
#include "tim.h"
#include "usart.h"
#include "gpio.h"

/* Private includes ----------------------------------------------------------*/
/* USER CODE BEGIN Includes */
#include "u8g2/u8g2.h"

/* USER CODE END Includes */

/* Private typedef -----------------------------------------------------------*/
/* USER CODE BEGIN PTD */

/* USER CODE END PTD */

/* Private define ------------------------------------------------------------*/
/* USER CODE BEGIN PD */
/* USER CODE END PD */

/* Private macro -------------------------------------------------------------*/
/* USER CODE BEGIN PM */

/* USER CODE END PM */

/* Private variables ---------------------------------------------------------*/

/* USER CODE BEGIN PV */

/* USER CODE END PV */

/* Private function prototypes -----------------------------------------------*/
void SystemClock_Config(void);
/* USER CODE BEGIN PFP */

/* USER CODE END PFP */

/* Private user code ---------------------------------------------------------*/
/* USER CODE BEGIN 0 */
#define bitmap_width 64
#define bitmap_height 16
static unsigned char bitmap[] = {
		0x00, 0x00, 0x00, 0x00, 0x00, 0x00, 0x00, 0x00, 0x00, 0x00, 0x00, 0x00, 0x00, 0x00, 0x00, 0x00,
		0x00, 0x00, 0x00, 0x00, 0x00, 0x00, 0x00, 0x00, 0x00, 0x00, 0x00, 0x00, 0x00, 0x00, 0x00, 0x00,
		0x00, 0x00, 0x00, 0x00, 0x00, 0x00, 0x00, 0x00, 0x00, 0x00, 0x00, 0x00, 0x00, 0x00, 0x00, 0x00,
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		0x00, 0x00, 0x00, 0x00, 0x00, 0x00, 0x00, 0x00, 0x00, 0x00, 0x00, 0x00, 0x00, 0x00, 0x00, 0x00
};

extern uint8_t u8x8_stm32_gpio_and_delay(u8x8_t *u8x8, uint8_t msg, uint8_t arg_int, void *arg_ptr);
extern uint8_t u8x8_byte_stm32_hw_i2c(u8x8_t *u8x8, uint8_t msg, uint8_t arg_int, void *arg_ptr);

static u8g2_t u8g2;

#define hare1_width 25
#define hare1_height 28
static unsigned char hare1_bits[] = {
   0x00, 0x08, 0x00, 0x00, 0x00, 0x77, 0x00, 0x00, 0x80, 0x80, 0x01, 0x00,
   0x00, 0x01, 0x02, 0x00, 0x00, 0x0e, 0x0c, 0x00, 0x00, 0x01, 0x30, 0x00,
   0x80, 0x00, 0x40, 0x00, 0x80, 0x00, 0x88, 0x00, 0x40, 0x1c, 0x1c, 0x01,
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   0x00, 0x18, 0x00, 0x00 };

#define hare2_width 30
#define hare2_height 28
static unsigned char hare2_bits[] = {
   0x00, 0xc0, 0x03, 0x00, 0x00, 0x20, 0x04, 0x00, 0x00, 0x20, 0x08, 0x00,
   0x00, 0x40, 0x10, 0x00, 0x00, 0x80, 0x20, 0x00, 0x00, 0x70, 0x40, 0x00,
   0x00, 0x08, 0x80, 0x01, 0x00, 0x04, 0x00, 0x02, 0x00, 0xf8, 0x00, 0x04,
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   0xc0, 0x0f, 0x00, 0x00 };

/*
  Function which responds for drawing
  */
void u8g2_prepare()
{
  u8g2_SetFont(&u8g2, u8g2_font_courB10_tr);
  u8g2_SetFontRefHeightExtendedText(&u8g2);
  u8g2_SetDrawColor(&u8g2, 1);
  u8g2_SetFontPosTop(&u8g2);
  u8g2_SetFontDirection(&u8g2, 0);
}

void u8g2_drawLogo(void)
{
    u8g2_SetFontMode(&u8g2,1);	// Transparent
    u8g2_SetDrawColor(&u8g2,1);

   u8g2_SetFontDirection(&u8g2, 0);
   u8g2_SetFont(&u8g2, u8g2_font_inb24_mf);
   u8g2_DrawStr(&u8g2, 0, 5, "U");

   u8g2_SetFontDirection(&u8g2, 1);
   u8g2_SetFont(&u8g2, u8g2_font_inb30_mn);
   u8g2_DrawStr(&u8g2, 51,8,"8");

   u8g2_SetFontDirection(&u8g2, 0);
   u8g2_SetFont(&u8g2, u8g2_font_inb24_mf);
   u8g2_DrawStr(&u8g2, 51,5,"g");
   u8g2_DrawStr(&u8g2, 67,5,"\xb2");

   u8g2_DrawHLine(&u8g2, 2, 35, 47);
   u8g2_DrawHLine(&u8g2, 3, 36, 47);
   u8g2_DrawVLine(&u8g2, 45, 32, 12);
   u8g2_DrawVLine(&u8g2, 46, 33, 12);

   u8g2_SetFont(&u8g2, u8g2_font_5x8_tr);

   u8g2_DrawStr(&u8g2, 1,54,"github.com/olikraus/u8g2");
}

void u8g2_box_frame(uint8_t a)
{
  u8g2_DrawStr(&u8g2, 0,0, "DrawBox");
  u8g2_DrawBox(&u8g2,0,15,20,10);
  u8g2_DrawBox(&u8g2,0+a,15,30,7);
//  u8g2_DrawStr(&u8g2, 0, 32, "DrawFrame");
//  u8g2_DrawFrame(&u8g2,0,15+32,20,10);
//  u8g2_DrawFrame(&u8g2,0+a,15+32,30,7);
}

void u8g2_disc_circle(uint8_t a)
{
  u8g2_DrawStr(&u8g2, 0, 0, "DrawDisc");
  u8g2_DrawDisc(&u8g2,10,22,7,U8G2_DRAW_ALL);
  u8g2_DrawDisc(&u8g2,24+a,20,5,U8G2_DRAW_ALL);
//  u8g2_DrawStr(&u8g2, 0, 32, "DrawCircle");
//  u8g2_DrawCircle(&u8g2,10,22+32,7,U8G2_DRAW_ALL);
//  u8g2_DrawCircle(&u8g2,24+a,20+32,5,U8G2_DRAW_ALL);
}

void u8g2_string(uint8_t a)
{
  u8g2_SetFontDirection(&u8g2,0);
  u8g2_DrawStr(&u8g2,70+a,31, " 0");
  u8g2_SetFontDirection(&u8g2,1);
  u8g2_DrawStr(&u8g2,68,0+a, " 90");
//  u8g2_SetFontDirection(&u8g2,2);
//  u8g2_DrawStr(&u8g2,70-a,31, " 180");
//  u8g2_SetFontDirection(&u8g2,3);
//  u8g2_DrawStr(&u8g2,72,64-a, " 270");
}

void u8g2_line(uint8_t a)
{
  u8g2_DrawStr(&u8g2, 0, 0, "DrawLine");
  u8g2_DrawLine(&u8g2,7+a, 15, 60-a, 60);
//  u8g2_DrawLine(&u8g2,7+a*2, 15, 80-a, 60);
//  u8g2_DrawLine(&u8g2,7+a*3, 15, 100-a, 60);
//  u8g2_DrawLine(&u8g2,7+a*4, 15, 120-a, 60);
}

void u8g2_hare(uint8_t a)
{
	u8g2_DrawStr(&u8g2, 0, 0,"DrawXBM");
	if((a&1) == 0)
	{
		u8g2_DrawXBM(&u8g2, 0+a, 30, hare1_width, hare1_height, hare1_bits);
	}
	else
	{
		u8g2_DrawXBM(&u8g2, 0+a, 30, hare2_width, hare2_height, hare2_bits);
	}
}

uint8_t max = 0;
uint8_t step = 0;
uint8_t picture =0;

void draw(void)
{
	u8g2_prepare();
	switch(picture)
	{
		case 0:
			u8g2_drawLogo();
		break;
		case 1:
			max = 80;
			u8g2_box_frame(step);
		break;
		case 2:
			max = 70;
			u8g2_disc_circle(step);
		break;
		case 3:
			max = 60;
			u8g2_string(step);
		break;
		case 4:
			max = 50;
			u8g2_line(step);
		break;
	}
}
/* USER CODE END 0 */

/**
  * @brief  The application entry point.
  * @retval int
  */
int main(void)
{
  /* USER CODE BEGIN 1 */

  /* USER CODE END 1 */

  /* MCU Configuration--------------------------------------------------------*/

  /* Reset of all peripherals, Initializes the Flash interface and the Systick. */
  HAL_Init();

  /* USER CODE BEGIN Init */

  /* USER CODE END Init */

  /* Configure the system clock */
  SystemClock_Config();

  /* USER CODE BEGIN SysInit */

  /* USER CODE END SysInit */

  /* Initialize all configured peripherals */
  MX_GPIO_Init();
  MX_USART1_UART_Init();
  MX_TIM7_Init();
  MX_TIM6_Init();
  MX_USART3_UART_Init();
  MX_RTC_Init();
  MX_I2C1_Init();
  /* USER CODE BEGIN 2 */
  u8g2_Setup_ssd1306_i2c_128x32_noname_f(&u8g2, U8G2_R0, u8x8_byte_stm32_hw_i2c, u8x8_stm32_gpio_and_delay);
  u8g2_InitDisplay(&u8g2);
  u8g2_SetPowerSave(&u8g2, 0);

  /* USER CODE END 2 */

  /* Infinite loop */
  /* USER CODE BEGIN WHILE */
  while (1)
  {
    /* USER CODE END WHILE */

    /* USER CODE BEGIN 3 */
//		u8g2_FirstPage(&u8g2);
//		do
//		{
//			u8g2_ClearBuffer(&u8g2);
//			u8g2_SetDrawColor(&u8g2,1);
//			u8g2_SetBitmapMode(&u8g2,1);
//			u8g2_DrawBitmap(&u8g2, 0, 0, bitmap_height, bitmap_width,  bitmap);
//
//		} while (u8g2_NextPage(&u8g2));

		u8g2_FirstPage(&u8g2);
		do
		{
			draw();
		}
		while ( u8g2_NextPage(&u8g2) ); // 8 times running

		if (step <= max)
			step += 3;
		else
		{
			step = 0;
			picture++;
			if ( picture >= 5)
				picture = 0;
		}

  }
  /* USER CODE END 3 */
}

/**
  * @brief System Clock Configuration
  * @retval None
  */
void SystemClock_Config(void)
{
  RCC_OscInitTypeDef RCC_OscInitStruct = {0};
  RCC_ClkInitTypeDef RCC_ClkInitStruct = {0};
  RCC_PeriphCLKInitTypeDef PeriphClkInitStruct = {0};

  /** Configure the main internal regulator output voltage
  */
  __HAL_RCC_PWR_CLK_ENABLE();
  __HAL_PWR_VOLTAGESCALING_CONFIG(PWR_REGULATOR_VOLTAGE_SCALE1);
  /** Initializes the RCC Oscillators according to the specified parameters
  * in the RCC_OscInitTypeDef structure.
  */
  RCC_OscInitStruct.OscillatorType = RCC_OSCILLATORTYPE_LSI|RCC_OSCILLATORTYPE_HSE;
  RCC_OscInitStruct.HSEState = RCC_HSE_ON;
  RCC_OscInitStruct.LSIState = RCC_LSI_ON;
  RCC_OscInitStruct.PLL.PLLState = RCC_PLL_ON;
  RCC_OscInitStruct.PLL.PLLSource = RCC_PLLSOURCE_HSE;
  RCC_OscInitStruct.PLL.PLLM = 4;
  RCC_OscInitStruct.PLL.PLLN = 168;
  RCC_OscInitStruct.PLL.PLLP = RCC_PLLP_DIV2;
  RCC_OscInitStruct.PLL.PLLQ = 7;
  if (HAL_RCC_OscConfig(&RCC_OscInitStruct) != HAL_OK)
  {
    Error_Handler();
  }
  /** Initializes the CPU, AHB and APB buses clocks
  */
  RCC_ClkInitStruct.ClockType = RCC_CLOCKTYPE_HCLK|RCC_CLOCKTYPE_SYSCLK
                              |RCC_CLOCKTYPE_PCLK1|RCC_CLOCKTYPE_PCLK2;
  RCC_ClkInitStruct.SYSCLKSource = RCC_SYSCLKSOURCE_PLLCLK;
  RCC_ClkInitStruct.AHBCLKDivider = RCC_SYSCLK_DIV1;
  RCC_ClkInitStruct.APB1CLKDivider = RCC_HCLK_DIV4;
  RCC_ClkInitStruct.APB2CLKDivider = RCC_HCLK_DIV2;

  if (HAL_RCC_ClockConfig(&RCC_ClkInitStruct, FLASH_LATENCY_5) != HAL_OK)
  {
    Error_Handler();
  }
  PeriphClkInitStruct.PeriphClockSelection = RCC_PERIPHCLK_RTC;
  PeriphClkInitStruct.RTCClockSelection = RCC_RTCCLKSOURCE_LSI;
  if (HAL_RCCEx_PeriphCLKConfig(&PeriphClkInitStruct) != HAL_OK)
  {
    Error_Handler();
  }
}

/* USER CODE BEGIN 4 */

/* USER CODE END 4 */

/**
  * @brief  This function is executed in case of error occurrence.
  * @retval None
  */
void Error_Handler(void)
{
  /* USER CODE BEGIN Error_Handler_Debug */
  /* User can add his own implementation to report the HAL error return state */
  __disable_irq();
  while (1)
  {
  }
  /* USER CODE END Error_Handler_Debug */
}

#ifdef  USE_FULL_ASSERT
/**
  * @brief  Reports the name of the source file and the source line number
  *         where the assert_param error has occurred.
  * @param  file: pointer to the source file name
  * @param  line: assert_param error line source number
  * @retval None
  */
void assert_failed(uint8_t *file, uint32_t line)
{
  /* USER CODE BEGIN 6 */
  /* User can add his own implementation to report the file name and line number,
     ex: printf("Wrong parameters value: file %s on line %d\r\n", file, line) */
  /* USER CODE END 6 */
}
#endif /* USE_FULL_ASSERT */

/************************ (C) COPYRIGHT STMicroelectronics *****END OF FILE****/
